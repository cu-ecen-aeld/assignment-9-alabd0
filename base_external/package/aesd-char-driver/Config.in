## base_external/package/aesd-char-driver/Config.in
```kconfig
config BR2_PACKAGE_AESD_CHAR_DRIVER
	bool "aesd-char-driver"
	depends on BR2_LINUX_KERNEL
	help
	  This is the "aesd-char-driver" kernel module.
```
